## Kconfig
```kconfig
# Move Determin Module Configuration

menuconfig MOVE_DETERMIN
    bool "Move Determin Module"
    default n
    help
      This option enables the Move Determin module, which is used for
      determining the movement of objects in a simulation environment.

config ZMK_INPUT_PROCESSOR_TEMP_LAYER_MAX_ACTION_EVENTS
    int "Temporary Layer Input Processor Max Action Events"
    default 4
    depends on MOVE_DETERMIN
```

## dts/bindings/input_processors/zmk,input-processor-move-determin.yaml
```yaml
description: Input Processor for Move Deterministic

compatible: "zmk,input-processor-move-determin"

include: ip_zero_param.yaml

properties:
  move-threshold:
    type: int
    description: |
      The threshold for movement to be considered significant.
      If the movement is less than this value, it will not trigger an action.
    requred: true
  window-ms:
    type: int
    description: |
      The time window in milliseconds during which the movement is considered.
      If the movement occurs within this time frame, it will be processed.
    required: true
```

## dts/bindings/input_processors/zmk,input-processor-move-temp-layer.yaml
```yaml
description: Input Processor for Move Deterministic

compatible: "zmk,input-processor-move-temp-layer"

include: ip_two_param.yaml

properties:
  move-threshold:
    type: int
    description: |
      The threshold for movement to be considered significant.
      If the movement is less than this value, it will not trigger an action.
    required: true
  window-ms:
    type: int
    description: |
      The time window in milliseconds during which the movement is considered.
      If the movement occurs within this time frame, it will be processed.
    required: true

  require-prior-idle-ms:
    type: int
    required: false
    default: 0
    description: |
      Required idle (no movement or key activity) time in ms before allowing activation.
      Prevents accidental or repeated activation.

  excluded-positions:
    type: array
    required: false
    default: []
    description: |
      List of position indices (usually key positions) that, when triggered, do not
      deactivate the temporary layer.
```

## west.yml
```yaml
manifest:
  remotes:
    - name: Senkoi
      url-base: https://github.com/Senkoi
  projects:
    - name: zmk-feature-move-determin
      remote: Senkoi
      import: west.yml
```
